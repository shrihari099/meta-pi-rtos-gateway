## conf/layer.conf
```bitbake
# We have a conf and classes directory, add to BBPATH
BBPATH .= ":${LAYERDIR}"

# We have recipes-* directories, add to BBFILES
BBFILES += "${LAYERDIR}/recipes-*/*/*.bb \
            ${LAYERDIR}/recipes-*/*/*.bbappend"

BBFILE_COLLECTIONS += "meta-pi-rtos-gateway"
BBFILE_PATTERN_meta-pi-rtos-gateway = "^${LAYERDIR}/"
BBFILE_PRIORITY_meta-pi-rtos-gateway = "6"

LAYERDEPENDS_meta-pi-rtos-gateway = "core"
LAYERSERIES_COMPAT_meta-pi-rtos-gateway = "kirkstone"
```

## raspi4Build/conf/bblayers.conf
```bitbake
# POKY_BBLAYERS_CONF_VERSION is increased each time build/conf/bblayers.conf
# changes incompatibly
POKY_BBLAYERS_CONF_VERSION = "2"

BBPATH = "${TOPDIR}"
BBFILES ?= ""

BBLAYERS ?= " \
  /home/hari/poky/meta \
  /home/hari/poky/meta-poky \
  /home/hari/poky/meta-yocto-bsp \
  /home/hari/meta-test \
  /home/hari/poky/meta-raspberrypi \
  "
```
